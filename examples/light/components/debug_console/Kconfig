## examples/light/components/debug_console/Kconfig
```kconfig
menu "Debug Console (GATT)"

config DEBUG_CONSOLE_GATT
    bool "Enable Debug Console over BLE GATT"
    default n
    help
      Enable the BLE GATT-based debug console for remote shell access.
      This console uses a custom 128-bit UUID service for RX/TX characteristics.

config DEBUG_CONSOLE_GATT_ENCRYPTED
    bool "Require pairing (encryption) for Console GATT RX"
    depends on DEBUG_CONSOLE_GATT
    default y
    help
      When enabled, writes to the console RX characteristic require an encrypted link.
      Unpaired writes will trigger pairing and be rejected until encryption is established.
      Bonds persist across reboots via NVS storage.

config DEBUG_CONSOLE_GATT_INPUT
    bool "Enable BLE GATT as console input (CHIP shell)"
    depends on DEBUG_CONSOLE_GATT
    default y
    help
      When enabled, BLE GATT RX writes are processed as CHIP shell commands.
      Commands are executed with the same mutex as UART to prevent conflicts.

config DEBUG_CONSOLE_GATT_TEE_LOGS
    bool "Tee ESP logs/printf to BLE console"
    depends on DEBUG_CONSOLE_GATT
    default y
    help
      When enabled, ESP_LOG* output is mirrored to BLE console TX in addition to UART.
      Uses non-blocking ring-buffer to prevent BLE from slowing down logging.

config DEBUG_CONSOLE_GATT_APPEND_CRLF
    bool "Append CRLF on newline for BLE console"
    depends on DEBUG_CONSOLE_GATT
    default y
    help
      When enabled, appends both CR and LF on newline for better BLE terminal compatibility.
      Disable to send only LF (Unix-style).

endmenu
```

## examples/light/main/Kconfig.projbuild
```kconfig
menu "Example Configuration"

    config ENABLE_MEMORY_PROFILING
        bool "Enable Memory Profiling"
        default n
        help
            Enable this option to include memory profiling features in the example.
            This will allow you to monitor memory usage during runtime.

endmenu

menu "Debugging"
    config BLE_SHELL_DEBUGGING_ENCRYPTED
        bool "Enable BLE shell debugging (encrypted)"
        default n
        help
          Adds a BLE UART-style console service that requires LE pairing.

    config BLE_CONSOLE_REQUIRE_BOND
        bool "Require bonded peer (not just encrypted) for BLE console"
        default y
        depends on BLE_SHELL_DEBUGGING_ENCRYPTED
        help
          When enabled (default), the console rejects access unless the peer
          is both encrypted AND bonded. If disabled, encrypted-but-unbonded
          peers are allowed.

    config BLE_CONSOLE_RATE_LIMIT
        bool "Enable TX rate limiter for BLE console notifications"
        default y
        depends on BLE_SHELL_DEBUGGING_ENCRYPTED
        help
          When enabled (default), outgoing notify traffic is throttled to
          avoid starving Matter/NimBLE. Tuned conservatively for ESP32-C3.
endmenu
```
